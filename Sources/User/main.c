#include <STC32G.H>
#include "intrins.h"
#include "stdio.h"

#include "tinymaix.h"

typedef     unsigned char   u8;
typedef     unsigned int    u16;
typedef     unsigned long   u32;

#define FOSC        35000000UL
#define BRT         (65536 - FOSC / 115200 / 4)
#define Timer0_Reload   (FOSC / 1000)      //Timer 0  1KHz

uint32_t systick = 0;
void Timer0_init(void)
{
        TR0 = 0;   

    #if (Timer0_Reload < 64)    
        #error "Timer0 too fast"

    #elif ((Timer0_Reload/12) < 65536UL)    
        ET0 = 1;    
    //  PT0 = 1;    
        TMOD &= ~0x03;
        TMOD |= 0;  
    //  T0_CT = 1; 
        T0_CT = 0;  
    //  T0CLKO = 1; 
        T0CLKO = 0; 

        #if (Timer0_Reload < 65536UL)
            T0x12 = 1;  //1T mode
            TH0 = (u8)((65536UL - Timer0_Reload) / 256);
            TL0 = (u8)((65536UL - Timer0_Reload) % 256);
        #else
            T0x12 = 0;  //12T mode
            TH0 = (u8)((65536UL - Timer0_Reload/12) / 256);
            TL0 = (u8)((65536UL - Timer0_Reload/12) % 256);
        #endif

        TR0 = 1;   

    #else
        #error "Timer0 too slow"
    #endif
}

void timer0_int (void) interrupt 1
{
   systick++;
	if(systick%1000==0)P10 = ~P10;
}

#if 1
static uint8_t mnist_pic[28*28]={
  0,  0,  0,  0,  0,  0,  0,  0,  0,  0,  0,  0,  0,  0,  0,  0,  0,  0,  0,  0,  0,  0,  0,  0,  0,  0,  0,  0,
  0,  0,  0,  0,  0,  0,  0,  0,  0,  0,  0,  0,  0,  0,  0,  0,  0,  0,  0,  0,  0,  0,  0,  0,  0,  0,  0,  0,
  0,  0,  0,  0,  0,  0,  0,  0,  0,  0,  0,  0,  0,  0,  0,  0,  0,  0,  0,  0,  0,  0,  0,  0,  0,  0,  0,  0,
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  0,  0,  0,  0,  0,  0,  0,  0,  0,  0,  0,  0,  0,  0,  0,  0,  0,  0,  0,  0,  0,  0,  0,  0,  0,  0,  0,  0,
};
#else
static uint8_t mnist_pic[28*28]={
  0,  0,  0,  0,  0,  0,  0,  0,  0,  0,  0,  0,  0,  0,  0,  0,  0,  0,  0,  0,  0,  0,  0,  0,  0,  0,  0,  0,
  0,  0,  0,  0,  0,  0,  0,  0,  0,  0,  0,  0,  0,  0,  0,  0,  0,  0,  0,  0,  0,  0,  0,  0,  0,  0,  0,  0,
  0,  0,  0,  0,  0,  0,  0,  0,  0,  0,  0,  0,  0,  0,  0,  0,  0,  0,  0,  0,  0,  0,  0,  0,  0,  0,  0,  0,
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  0,  0,  0,  0,  0,  0,  0,  0,  0,  0,  0,  0,  0,  0,  0,  0,  0,  0,  0,  0,  0,  0,  0,  0,  0,  0,  0,  0,
};
#endif

#include "mnist_valid_q_be.h"



bit busy;
char wptr;
char rptr;
char buffer[16];

#define IMG_L   (28)
#define IMG_CH  (1)
#define CLASS_N (10)

static tm_err_t layer_cb(tm_mdl_t* mdl, tml_head_t* lh)
{   //dump middle result
	  int x,y,c;
    int h = lh->out_dims[1];
    int w = lh->out_dims[2];
    int ch= lh->out_dims[3];
	  mtype_t* output = TML_GET_OUTPUT(mdl, lh);
    return TM_OK;
    TM_PRINTF("Layer %d callback ========\n", mdl->layer_i);
    #if 1
    for(y=0; y<h; y++){
        TM_PRINTF("[");
        for(x=0; x<w; x++){
            TM_PRINTF("[");
            for(c=0; c<ch; c++){
            #if TM_MDL_TYPE == TM_MDL_FP32
                TM_PRINTF("%.3f,", output[(y*w+x)*ch+c]);
            #else
                TM_PRINTF("%.3f,", TML_DEQUANT(lh,output[(y*w+x)*ch+c]));
            #endif
            }
            TM_PRINTF("],");
        }
        TM_PRINTF("],\n");
    }
    TM_PRINTF("\n");
    #endif
    return TM_OK;
}

static uint8_t mdl_buf[MDL_BUF_LEN];

static void parse_output(tm_mat_t* outs)
{
    tm_mat_t out = outs[0];
    float* dat  = (float*)out.dat;
    float maxp = 0;
    int maxi = -1;
	  int i=0;
    for(; i<CLASS_N; i++){
        if(dat[i] > maxp) {
            maxi = i;
            maxp = dat[i];
        }
    }
    TM_PRINTF("### Predict output is: Number %d , Prob %.3f\r\n", maxi, maxp);
    return;
}

void UartIsr() interrupt 4
{
    if (TI)
    {
        TI = 0;
        busy = 0;
    }
    if (RI)
    {
        RI = 0;
        buffer[wptr++] = SBUF;
        wptr &= 0x0f;
    }
}

static void UartInit()
{
    SCON = 0x50;
	
    P_SW1 &= 0x3f;
	  P_SW1 |= 0x40;  //P3.6 RXD, P3.7 TXD
	
    T2L = BRT;
    T2H = BRT >> 8;
    AUXR = 0x15;
    wptr = 0x00;
    rptr = 0x00;
    busy = 0;
}

void UartSend(char dat)
{
    while (busy);
    busy = 1;
    SBUF = dat;
}

void UartSendStr(char *p)
{
    while (*p)
    {
        UartSend(*p++);
    }
}

void delay_ms(u8 ms)
{
     u16 i;
     do{
          i = FOSC / 6000;
          while(--i);   //6T per loop
     }while(--ms);
}
#define DELAY_T 50
void main( void )
{
	  tm_mdl_t mdl;
	  int i;
    tm_mat_t in_uint8; 
    tm_mat_t in; 
    tm_mat_t outs[1];
    tm_err_t res;
	  TM_DBGT_INIT();
	
    WTST = 0;  //cpu fast
    EAXFR = 1; //enable eaxfr
    CKCON = 0; //XRAM fast
	
    P0M0 = 0x00;
    P0M1 = 0x00;
    P1M0 = 0x00;
    P1M1 = 0x00;
    P2M0 = 0x00;
    P2M1 = 0x00;
    P3M0 = 0x00;
    P3M1 = 0x00;
    P4M0 = 0x00;
    P4M1 = 0x00;
    P5M0 = 0x00;
    P5M1 = 0x00;

	  UartInit();
    ES = 1;
    EA = 1;
		
		Timer0_init();
		
		in_uint8.dims = 3;
    in_uint8.h    = IMG_L;
    in_uint8.w    = IMG_L;
    in_uint8.c    = IMG_CH;
    in_uint8.dat  = (mtype_t*)mnist_pic;
		
		in.dims = 3;
    in.h    = IMG_L;
    in.w    = IMG_L;
    in.c    = IMG_CH;
    in.dat  = NULL;
		
		/*while(1){
			UartSend('X');
			delay_ms(10);
        P37 = 0;		//LED On
        delay_ms(10);
        P37 = 1;		//LED Off
		}*/
	
    TM_PRINTF("mnist demo\r\n");

    for(i=0 ; i<28*28; i++){
        TM_PRINTF("%3d,", mnist_pic[i]);
        if(i%28==27)printf("\r\n");
    }
		
		tm_stat((tm_mdlbin_t*)mdl_data); 

    res = tm_load(&mdl, mdl_data, mdl_buf, layer_cb, &in);
    if(res != TM_OK) {
        TM_PRINTF("tm model load err %d\r\n", res);
        return ;
    }

    res = tm_preprocess(&mdl, TMPP_UINT2INT, &in_uint8, &in); 
		
    TM_DBGT_START();
    res = tm_run(&mdl, &in, outs);
    TM_DBGT("tm_run");

    if(res==TM_OK) parse_output(outs);  
    else TM_PRINTF("tm run error: %d\r\n", res);
    tm_unload(&mdl);  

    while (1);
}